## Kconfig
```kconfig
#
# SPDX-License-Identifier: BSD-3-Clause
# Copyright (c) 2026 HMS Industrial Networks GmbH & Co. KG
# Author: Isaac L. L. Yuki 
#

config BMTH_ENABLE
    bool "Enable HMS Benchmark Tool"
    default n
    help
      Select this option to enable the HMS Benchmark Tool.

config BMTH_FRDM_MCXN947
    depends on BMTH_ENABLE
    bool "FRDM-MCXN947"
    default n
    help
      Select this option to enable the FRDM-MCXN947 board support for the HMS Benchmark Tool.

config BMTH_TEST_MEM_ALLOC
    bool "Allocation tests"
    help

      All allocation tests run the same workloads out of
      over an arena of MEM_ARENA_SIZE bytes
      (MEM_ARENA_MULTIPLIER * MEM_REQUESTED_SPACE, src/mem/mem_harness.h).
      The adapter is the only file that knows which allocator is under
      test. See src/mem/README.md.
```
